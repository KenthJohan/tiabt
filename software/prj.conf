## CMakeLists.txt
```
# SPDX-License-Identifier: Apache-2.0

cmake_minimum_required(VERSION 3.20.0)
find_package(Zephyr REQUIRED HINTS $ENV{ZEPHYR_BASE})
project(tiabt)

FILE(GLOB app_sources src/*.c)
target_sources(app PRIVATE ${app_sources})
```

## prj.conf
```kconfig
CONFIG_BT=y
CONFIG_BT_PERIPHERAL=y
CONFIG_BT_SMP=y
CONFIG_TINYCRYPT=y
CONFIG_BT_DEVICE_NAME="TIABT"
CONFIG_BT_DIS=y
CONFIG_BT_DIS_PNP=n
CONFIG_BT_BAS=y
CONFIG_BT_DEVICE_APPEARANCE=768
CONFIG_SPI=y
CONFIG_STDOUT_CONSOLE=y
CONFIG_LOG=y
CONFIG_GPIO=y
```

## boards/_nrf52840dongle_nrf52840.overlay
```dts
&spi1 {
	pinctrl-0 = <NRF_PSEL(SPIM_SCK, 1, 13)>,
				<NRF_PSEL(SPIM_MOSI, 1, 15)>,
				<NRF_PSEL(SPIM_MISO, 0, 29)>;
	pinctrl-names = "default";
	status = "okay";
};
```

## boards/nucleo_wb55rg.overlay
```dts
&spi1 {
	pinctrl-0 = <&spi1_nss_pa4 &spi1_sck_pa5
		     &spi1_miso_pa6 &spi1_mosi_pa7>;
	pinctrl-names = "default";
	status = "okay";
	cs-gpios = <&gpioa 4 GPIO_ACTIVE_LOW>;
};
```

## src/main.c
```c
#include <stdbool.h>
#include <zephyr/types.h>
#include <stddef.h>
#include <string.h>
#include <errno.h>
#include <sys/printk.h>
#include <sys/byteorder.h>
#include <zephyr.h>
#include <sys/__assert.h>
#include <drivers/gpio.h>
#include <drivers/spi.h>
#include <drivers/pinctrl.h>
#include <zephyr.h>
#include <device.h>
#include <devicetree.h>
#include <drivers/gpio.h>

//#include "adc.h"
#include "bt.h"




void main(void)
{
	mybt_init();
	
	//init_adc();

	//gpio_pin_configure_dt(&led1, GPIO_OUTPUT_ACTIVE);
	//gpio_pin_configure_dt(&led2, GPIO_OUTPUT_ACTIVE);
	//gpio_pin_configure_dt(&led3, GPIO_OUTPUT_ACTIVE);
	/*
	gpio_pin_toggle_dt(&led1);
	gpio_pin_toggle_dt(&led2);
	gpio_pin_toggle_dt(&led3);
	*/
	
	while (1)
	{
		k_sleep(K_MSEC(1000));
		mybt_progress();
	}
}
```

## src/MCP356X.h
```c
#pragma once

// https://github.com/MikroElektronika/mikrosdk_click_v2
// https://github.com/MikroElektronika/mikrosdk_click_v2/tree/master/clicks/adc9
// https://github.com/jspark311/MCP356x-Breakout/blob/6cc57254ad991eba59b2607941b86dc148f06eaf/Arduino/src/MCP356x.cpp






/*****************************************************************
6.2.1 COMMAND BYTE STRUCTURE
The COMMAND byte fully defines the command that
will be executed by the part. This byte is divided into
three parts: the device address bits (CMD[7:6]), the
command address bits (CMD[5:2]) and the
command-type bits (CMD[1:0]).
*****************************************************************/
#define MCP356X_COMMAND_BYTE(addr, cmd, type) (((addr)<<6) | ((cmd)<<2) | ((type)<<0))

/*****************************************************************
6.2.2 DEVICE ADDRESS BITS (CMD[7:6])
The SPI interface of the MCP3561/2/4 devices is
addressable, which means that multiple devices can
communicate on the same SPI bus with only one Chip
Select line for all devices. Each device communication
starts by a CS falling edge, followed by the clocking of
the device address (CMD[7:6]). Each device contains
an internal device address which the device can
respond to.
This address is coded on two bits, so four possible
addresses are available. Device address is hard-coded
within the device and should be determined when
ordering the device. The device address is part of the
device markings to avoid potential confusion (see
Sections 9.1 “Package Marking Information(1)”).
When the CMD[7:6] bits match the device address, the
communication will proceed and the part will execute
the commands defined in the control byte and its
subsequent data bytes.
When the CMD[7:6] bits do not correspond to the
address hard-coded in the device, the command is
ignored. In this case, the SDO output will become
high-impedance, which prevents bus contention errors
when multiple devices are connected on the same SPI
bus (see Figure 6-2). The user has to exit from this
communication through a CS rising edge to be able to
launch another command.
*****************************************************************/
#define MCP356X_DEVICE_ADR                   0x01 // CMD[7:6]

/*****************************************************************
6.2.4 COMMAND-TYPE BITS (CMD[1:0])
The last two bits of the COMMAND register byte define
the command type. These bits are an extension of the
typical read/write bits present in most SPI communica-
tion protocols. The two bits define four possible
command types: Incremental Write, Incremental Read,
Static Read and Fast command. Changing the com-
mand type within the same communication (while CS is
logic low) is not possible. The communication has to be
stopped (CS rising edge) and restarted (CS falling
edge) to change its command type.
*****************************************************************/
#define MCP356X_CMD_DONT_CARE                0x00
#define MCP356X_CMD_STAT_READ                0x01
#define MCP356X_CMD_INC_WRITE                0x02
#define MCP356X_CMD_INC_READ                 0x03

/*****************************************************************
8.0 INTERNAL REGISTERS
The MCP3561/2/4 devices have a total of 16 internal
registers made of volatile memory.
*****************************************************************/
#define MCP356X_REG_ADC_DATA                 0x00
#define MCP356X_REG_CFG_0                    0x01
#define MCP356X_REG_CFG_1                    0x02
#define MCP356X_REG_CFG_2                    0x03
#define MCP356X_REG_CFG_3                    0x04
#define MCP356X_REG_IRQ                      0x05
#define MCP356X_REG_MUX                      0x06
#define MCP356X_REG_SCAN                     0x07
#define MCP356X_REG_TIMER                    0x08
#define MCP356X_REG_OFFSET_CAL               0x09
#define MCP356X_REG_GAIN_CAL                 0x0A
#define MCP356X_RSV_REG_W_A                  0x0B
#define MCP356X_REG_LOCK                     0x0D
#define MCP356X_RSV_REG                      0x0E
#define MCP356X_REG_CRC_CFG                  0x0F

static char const * MCP356X_REG_tostring(int a)
{
	switch(a)
	{
	case MCP356X_REG_ADC_DATA    : return "MCP356X_REG_ADC_DATA    ";
	case MCP356X_REG_CFG_0       : return "MCP356X_REG_CFG_0       ";
	case MCP356X_REG_CFG_1       : return "MCP356X_REG_CFG_1       ";
	case MCP356X_REG_CFG_2       : return "MCP356X_REG_CFG_2       ";
	case MCP356X_REG_CFG_3       : return "MCP356X_REG_CFG_3       ";
	case MCP356X_REG_IRQ         : return "MCP356X_REG_IRQ         ";
	case MCP356X_REG_MUX         : return "MCP356X_REG_MUX         ";
	case MCP356X_REG_SCAN        : return "MCP356X_REG_SCAN        ";
	case MCP356X_REG_TIMER       : return "MCP356X_REG_TIMER       ";
	case MCP356X_REG_OFFSET_CAL  : return "MCP356X_REG_OFFSET_CAL  ";
	case MCP356X_REG_GAIN_CAL    : return "MCP356X_REG_GAIN_CAL    ";
	case MCP356X_RSV_REG_W_A     : return "MCP356X_RSV_REG_W_A     ";
	case MCP356X_REG_LOCK        : return "MCP356X_REG_LOCK        ";
	case MCP356X_RSV_REG         : return "MCP356X_RSV_REG         ";
	case MCP356X_REG_CRC_CFG     : return "MCP356X_REG_CRC_CFG     ";
	default:return "";
	}
}




/*****************************************************************
8.2 CONFIG0 Register
ADC Operating mode, Master Clock mode and Input Bias Current
Source mode
******************************************************************/
// Full Shutdown Mode Enable
#define MCP356X_CFG_0_VREF_SEL_0             0x00
#define MCP356X_CFG_0_VREF_SEL_1             0x40
#define MCP356X_CFG_0_VREF_SEL_2             0x80
#define MCP356X_CFG_0_VREF_SEL_3             0xC0
// Clock Selection
#define MCP356X_CFG_0_CLK_SEL_0              0x00
#define MCP356X_CFG_0_CLK_SEL_1              0x10
#define MCP356X_CFG_0_CLK_SEL_2              0x20
#define MCP356X_CFG_0_CLK_SEL_3              0x30
// Current Source/Sink Selection Bits for Sensor Bias (source on VIN+/sink on VIN-)
#define MCP356X_CFG_0_CS_SEL_0               0x00
#define MCP356X_CFG_0_CS_SEL_1               0x04
#define MCP356X_CFG_0_CS_SEL_2               0x08
#define MCP356X_CFG_0_CS_SEL_3               0x0C
// ADC Operating Mode Selection
#define MCP356X_CFG_0_MODE_SHD_DEF           0x00
#define MCP356X_CFG_0_MODE_SHD               0x01
#define MCP356X_CFG_0_MODE_STANDBY           0x02
#define MCP356X_CFG_0_MODE_CONV              0x03




/******************************************************************
8.3 CONFIG1 Register
Prescale and OSR settings
******************************************************************/
// Prescaler Value Selection for AMCLK
#define MCP356X_CFG_1_PRE_1                  0x00
#define MCP356X_CFG_1_PRE_2                  0x40
#define MCP356X_CFG_1_PRE_4                  0x80
#define MCP356X_CFG_1_PRE_8                  0xC0
// Oversampling Ratio for Delta-Sigma A/D Conversion
#define MCP356X_CFG_1_OSR_98304              0x3C
#define MCP356X_CFG_1_OSR_81920              0x38
#define MCP356X_CFG_1_OSR_49152              0x34
#define MCP356X_CFG_1_OSR_40960              0x30
#define MCP356X_CFG_1_OSR_24576              0x2C
#define MCP356X_CFG_1_OSR_20480              0x28
#define MCP356X_CFG_1_OSR_16384              0x24
#define MCP356X_CFG_1_OSR_8192               0x20
#define MCP356X_CFG_1_OSR_4096               0x1C
#define MCP356X_CFG_1_OSR_2048               0x18
#define MCP356X_CFG_1_OSR_1024               0x14
#define MCP356X_CFG_1_OSR_512                0x10
#define MCP356X_CFG_1_OSR_256                0x0C
#define MCP356X_CFG_1_OSR_128                0x08
#define MCP356X_CFG_1_OSR_64                 0x04
#define MCP356X_CFG_1_OSR_32                 0x00
// RESERVED[1:0]: Should always be set to ‘00’
#define MCP356X_CFG_1_DITHER_MAX             0x03
#define MCP356X_CFG_1_DITHER_MED             0x02
#define MCP356X_CFG_1_DITHER_MIN             0x01
#define MCP356X_CFG_1_DITHER_DEF             0x00





/******************************************************************
8.4 CONFIG2 Register
ADC boost and gain settings, auto-zeroing settings for analog
multiplexer, voltage reference and ADC
******************************************************************/
// ADC Bias Current Selection
#define MCP356X_CFG_2_BOOST_X_2              0xC0
#define MCP356X_CFG_2_BOOST_X_1              0x80
#define MCP356X_CFG_2_BOOST_X_066            0x40
#define MCP356X_CFG_2_BOOST_X_05             0x00
// ADC Gain Selection
#define MCP356X_CFG_2_GAIN_X_64              0x38
#define MCP356X_CFG_2_GAIN_X_32              0x30
#define MCP356X_CFG_2_GAIN_X_16              0x28
#define MCP356X_CFG_2_GAIN_X_8               0x20
#define MCP356X_CFG_2_GAIN_X_4               0x18
#define MCP356X_CFG_2_GAIN_X_2               0x10
#define MCP356X_CFG_2_GAIN_X_1               0x08
#define MCP356X_CFG_2_GAIN_X_033             0x00
// Auto-Zeroing MUX Setting
#define MCP356X_CFG_2_AZ_MUX_EN              0x04
#define MCP356X_CFG_2_AZ_MUX_DIS             0x00
#define MCP356X_CFG_2_AZ_VREF_EN             0x02
#define MCP356X_CFG_2_AZ_VREF_DIS            0x00
// RESERVED[1:0]: Should always be equal to ‘11’
#define MCP356X_CFG_2_AZ_FREQ_HIGH           0x01
#define MCP356X_CFG_2_AZ_FREQ_LOW            0x00




/******************************************************************
8.5 CONFIG3 Register
Conversion mode, data and CRC format settings; enable for CRC on
communications, enable for digital offset and gain error calibrations
*******************************************************************/
// Conversion Mode Selection
#define MCP356X_CFG_3_CONV_MODE_CONT         0xC0
#define MCP356X_CFG_3_CONV_MODE_STANDBY      0x80
#define MCP356X_CFG_3_CONV_MODE_SHD          0x40
#define MCP356X_CFG_3_CONV_MODE_SHD0         0x00

// ADC Output Data Format Selection

// 32-bit (25-bit right justified data + Channel ID): CHID[3:0] + SGN extension (4 bits) + 24-bit ADC data. 
// It allows overrange with the SGN extension.
#define MCP356X_CFG_3_DATA_FORMAT_CH_ADC     0x30
// 32-bit (25-bit right justified data): SGN extension (8-bit) + 24-bit ADC data. It allows overrange with the SGN extension.
#define MCP356X_CFG_3_DATA_FORMAT_SIGN_ADC   0x20
// 32-bit (24-bit left justified data): 24-bit ADC data + 0x00 (8-bit). It does not allow overrange (ADC code locked to 0xFFFFFF or 0x800000).
#define MCP356X_CFG_3_DATA_FORMAT_LEFT_JUST  0x10
//24-bit (default ADC coding): 24-bit ADC data. It does not allow overrange (ADC code locked to 0xFFFFFF or 0x800000).
#define MCP356X_CFG_3_DATA_FORMAT_DEF        0x00

// CRC Checksum Format Selection on Read Communications
#define MCP356X_CFG_3_CRC_FORMAT_32          0x08
#define MCP356X_CFG_3_CRC_FORMAT_16          0x00
// CRC Checksum Selection on Read Communications (it does not affect CRCCFG calculations)
#define MCP356X_CFG_3_CRC_COM_EN             0x04
#define MCP356X_CFG_3_CRC_COM_DIS            0x00
// Enable Digital Offset Calibration
#define MCP356X_CFG_3_CRC_OFF_CAL_EN         0x02
#define MCP356X_CFG_3_CRC_OFF_CAL_DIS        0x00
// Enable Digital Gain Calibration
#define MCP356X_CFG_3_CRC_GAIN_CAL_EN        0x01
#define MCP356X_CFG_3_CRC_GAIN_CAL_DIS       0x00

struct mcp356x_data11
{
	uint8_t channel;
	uint32_t value;
};


/*******************************************************************
8.6 IRQ Register
IRQ Status bits and IRQ mode settings; enable for Fast commands and
for conversion start pulse
*******************************************************************/
#define MCP356X_IRQ_MODE_MDAT                0x08
#define MCP356X_IRQ_MODE_IRQ                 0x00
#define MCP356X_IRQ_MODE_LOGIC_HIGH          0x04
#define MCP356X_IRQ_MODE_HIGH_Z              0x00
#define MCP356X_IRQ_FASTCMD_EN               0x02
#define MCP356X_IRQ_FASTCMD_DIS              0x00
#define MCP356X_IRQ_STP_EN                   0x01
#define MCP356X_IRQ_STP_DIS                  0x00





/*******************************************************************
8.7 MULTIPLEXER (MUX) REGISTER
Analog multiplexer input selection (MUX mode only)
*******************************************************************/
// Bit 7-4 MUX_VIN+ Input Selection
#define MCP356X_MUX_VIN_POS_NO_IN            0xF0 // 1111 0000 Internal VCM
#define MCP356X_MUX_VIN_POS_VCM              0xE0 // 1110 0000 Internal Temperature Sensor Diode M (Temp Diode M)(1)
#define MCP356X_MUX_VIN_POS_TEMP             0xD0 // 1101 0000 Internal Temperature Sensor Diode P (Temp Diode P)(1)
#define MCP356X_MUX_VIN_POS_VREF_EXT_MINUS   0xC0 // 1100 0000
#define MCP356X_MUX_VIN_POS_VREF_EXT_PLUS    0xB0 // 1011 0000
#define MCP356X_MUX_VIN_POS_VREF_INT         0xA0 // 1010 0000 Reserved (do not use)
#define MCP356X_MUX_VIN_POS_AVDD             0x90 // 1001 0000
#define MCP356X_MUX_VIN_POS_AGND             0x80 // 1000 0000
#define MCP356X_MUX_VIN_POS_CH7              0x70 // 0111 0000
#define MCP356X_MUX_VIN_POS_CH6              0x60 // 0110 0000
#define MCP356X_MUX_VIN_POS_CH5              0x50 // 0101 0000
#define MCP356X_MUX_VIN_POS_CH4              0x40 // 0100 0000
#define MCP356X_MUX_VIN_POS_CH3              0x30 // 0011 0000
#define MCP356X_MUX_VIN_POS_CH2              0x20 // 0010 0000
#define MCP356X_MUX_VIN_POS_CH1              0x10 // 0001 0000
#define MCP356X_MUX_VIN_POS_CH0              0x00 // 0000 0000
// Bit 3-0 MUX_VIN- Input Selection
#define MCP356X_MUX_VIN_NEG_NO_IN            0x0F // 0000 1111
#define MCP356X_MUX_VIN_NEG_VCM              0x0E // 0000 1110 Internal Temperature Sensor Diode M (Temp Diode M)(1)
#define MCP356X_MUX_VIN_NEG_TEMP             0x0D // 0000 1101 Internal Temperature Sensor Diode P (Temp Diode P)(1)
#define MCP356X_MUX_VIN_NEG_VREF_EXT_MINUS   0x0C // 0000 1100
#define MCP356X_MUX_VIN_NEG_VREF_EXT_PLUS    0x0B // 0000 1011
#define MCP356X_MUX_VIN_NEG_VREF_INT         0x0A // 0000 1010 Reserved (do not use)
#define MCP356X_MUX_VIN_NEG_AVDD             0x09 // 0000 1001
#define MCP356X_MUX_VIN_NEG_AGND             0x08 // 0000 1000
#define MCP356X_MUX_VIN_NEG_CH7              0x07 // 0000 0111
#define MCP356X_MUX_VIN_NEG_CH6              0x06 // 0000 0110
#define MCP356X_MUX_VIN_NEG_CH5              0x05 // 0000 0101
#define MCP356X_MUX_VIN_NEG_CH4              0x04 // 0000 0100
#define MCP356X_MUX_VIN_NEG_CH3              0x03 // 0000 0011
#define MCP356X_MUX_VIN_NEG_CH2              0x02 // 0000 0010
#define MCP356X_MUX_VIN_NEG_CH1              0x01 // 0000 0001
#define MCP356X_MUX_VIN_NEG_CH0              0x00 // 0000 0000




// 8.8 SCAN Register
// Bit 23-21 DLY[2:0]: Delay Time (TDLY_SCAN) Between Each Conversion During a Scan Cycle
#define MCP356X_SCAN_DLY_DM_CLK_X_512        0x00E00000
#define MCP356X_SCAN_DLY_DM_CLK_X_256        0x00C00000
#define MCP356X_SCAN_DLY_DM_CLK_X_128        0x00A00000
#define MCP356X_SCAN_DLY_DM_CLK_X_64         0x00800000
#define MCP356X_SCAN_DLY_DM_CLK_X_32         0x00600000
#define MCP356X_SCAN_DLY_DM_CLK_X_16         0x00400000
#define MCP356X_SCAN_DLY_DM_CLK_X_8          0x00200000
#define MCP356X_SCAN_DLY_NO_DELAY            0x00000000
//Bit 19-16 Unimplemented: Read as ‘0’
#define MCP356X_SCAN_PSAV_VREF_OFF           0x00100000
#define MCP356X_SCAN_PSAV_VREF_ON            0x00000000
// Bit 15-0 Scan Channel Selection (see Table 5-14 for a complete description)
#define MCP356X_SCAN_OFFSET                  0x00008000
#define MCP356X_SCAN_VREF                    0x00004000
#define MCP356X_SCAN_AVDD                    0x00002000
#define MCP356X_SCAN_TEMP                    0x00001000
#define MCP356X_SCAN_DIFF_D                  0x00000800
#define MCP356X_SCAN_DIFF_C                  0x00000400
#define MCP356X_SCAN_DIFF_B                  0x00000200
#define MCP356X_SCAN_DIFF_A                  0x00000100
#define MCP356X_SCAN_CH7                     0x00000080
#define MCP356X_SCAN_CH6                     0x00000040
#define MCP356X_SCAN_CH5                     0x00000020
#define MCP356X_SCAN_CH4                     0x00000010
#define MCP356X_SCAN_CH3                     0x00000008
#define MCP356X_SCAN_CH2                     0x00000004
#define MCP356X_SCAN_CH1                     0x00000002
#define MCP356X_SCAN_CH0                     0x00000001

// 8.9 TIMER Register
#define MCP356X_TIMER_DLY_DMCLK_X_16777215   0x00FFFFFF
#define MCP356X_TIMER_DLY_DMCLK_X_8388607    0x007FFFFF
#define MCP356X_TIMER_DLY_DMCLK_X_4194303    0x003FFFFF
#define MCP356X_TIMER_DLY_DMCLK_X_2097151    0x001FFFFF
#define MCP356X_TIMER_DLY_DMCLK_X_1048575    0x000FFFFF
#define MCP356X_TIMER_DLY_DMCLK_X_524287     0x0007FFFF
#define MCP356X_TIMER_DLY_DMCLK_X_262143     0x0003FFFF
#define MCP356X_TIMER_DLY_DMCLK_X_131071     0x0001FFFF
#define MCP356X_TIMER_DLY_DMCLK_X_65535      0x0000FFFF
#define MCP356X_TIMER_DLY_DMCLK_X_32767      0x00007FFF
#define MCP356X_TIMER_DLY_DMCLK_X_16383      0x00003FFF
#define MCP356X_TIMER_DLY_DMCLK_X_8191       0x00001FFF
#define MCP356X_TIMER_DLY_DMCLK_X_4095       0x00000FFF
#define MCP356X_TIMER_DLY_DMCLK_X_2047       0x000007FF
#define MCP356X_TIMER_DLY_DMCLK_X_1023       0x000003FF
#define MCP356X_TIMER_DLY_DMCLK_X_511        0x000001FF
#define MCP356X_TIMER_DLY_DMCLK_X_255        0x000000FF
#define MCP356X_TIMER_DLY_DMCLK_X_127        0x0000007F
#define MCP356X_TIMER_DLY_DMCLK_X_63         0x0000003F
#define MCP356X_TIMER_DLY_DMCLK_X_31         0x0000001F
#define MCP356X_TIMER_DLY_DMCLK_X_15         0x0000000F
#define MCP356X_TIMER_DLY_DMCLK_X_2          0x00000002
#define MCP356X_TIMER_DLY_DMCLK_X_1          0x00000001
#define MCP356X_TIMER_DLY_NO_DELAY           0x00000000

#define MCP356X_FAST_CMD_ADC_CONV_START      0x28
#define MCP356X_FAST_CMD_ADC_STANDBY_MODE    0x2C
#define MCP356X_FAST_CMD_ADC_SHUTDOWN_MODE   0x30
#define MCP356X_FAST_CMD_FULL_SHUTDOWN_MODE  0x34
#define MCP356X_FAST_CMD_DEV_FULL_RESET      0x38

#define MCP356X_CALC_COEF                    8388608




/*
111 = Gain is x64 (x16 analog, x4 digital)
110 = Gain is x32 (x16 analog, x2 digital)
101 = Gain is x16
100 = Gain is x8
011 = Gain is x4
010 = Gain is x2
001 = Gain is x1 (default)
000 = Gain is x1/3
*/

static int32_t MCP356X_raw_to_mv(int32_t raw, int32_t vref, int32_t gain)
{
	int32_t c = (MCP356X_CALC_COEF / vref);
	switch(gain)
	{
	case MCP356X_CFG_2_GAIN_X_64  : c *= 64; break;
	case MCP356X_CFG_2_GAIN_X_32  : c *= 32; break;
	case MCP356X_CFG_2_GAIN_X_16  : c *= 16; break;
	case MCP356X_CFG_2_GAIN_X_8   : c *= 8; break;
	case MCP356X_CFG_2_GAIN_X_4   : c *= 4; break;
	case MCP356X_CFG_2_GAIN_X_2   : c *= 2; break;
	case MCP356X_CFG_2_GAIN_X_1   : c *= 1; break;
	case MCP356X_CFG_2_GAIN_X_033 : c /= 3; break;
	}
	int32_t mv;
	mv = raw / c;
	return mv;
}
```

## src/adc.h
```c
#pragma once
#include "MCP356X.h"



// The ADC9 uses 2000mV voltage ref chip MCP1501
#define VREF  2048


// https://os.mbed.com/platforms/ST-Nucleo-WB55RG/
// https://github.com/zephyrproject-rtos/zephyr/blob/main/boards/arm/nucleo_wb55rg/nucleo_wb55rg.dts
/*
&spi1 {
	pinctrl-0 = <&spi1_nss_pa4 &spi1_sck_pa5
		     &spi1_miso_pa6 &spi1_mosi_pa7>;
	pinctrl-names = "default";
	status = "okay";
};
*/
// ADC pin CSK ---orange--- (PA5,D13,20,SCK)
// ADC pin SDO ---yellow--- (PA6,D12,21,MISO)
// ADC pin SDI ---green---- (PA7,D11,22,MOSI)
// ADC pin CS  ---white---- (PA4,D10)
// https://github.com/zephyrproject-rtos/zephyr-testing/blob/0f09360456592ecf0d0413352dc1ef5d23cd0364/include/drivers/spi.h#L252
// https://github.com/zephyrproject-rtos/zephyr-testing/blob/2fc0ace3c2462cb33dc8c25e33c629cedba08ebb/boards/arm/rm1xx_dvk/rm1xx_dvk.dts#L60
// https://github.com/zephyrproject-rtos/zephyr/blob/ee91cd5665b1590c9a8a9a992bb19d81feeeb461/boards/arm/bt610/bt610.dts#L268

//struct spi_cs_control *ctrl = SPI_CS_CONTROL_PTR_DT(DT_NODELABEL(spi1), 2);
//struct spi_dt_spec spi_spec1 = SPI_DT_SPEC_GET(DT_NODELABEL(spi1), SPI_WORD_SET(8) | SPI_MODE_GET(0), 1);

struct spi_dt_spec spi_spec = 
{
	.bus = DEVICE_DT_GET(DT_NODELABEL(spi1)),
	.config = 
	{
		.operation = SPI_WORD_SET(8) | SPI_MODE_GET(0),
		.frequency = 1*1000*1000,
		.cs = &(struct spi_cs_control) 
		{
			.gpio_dev = DEVICE_DT_GET(DT_NODELABEL(gpioa)),
			.delay = 1,
			.gpio_pin = 4,
			.gpio_dt_flags = GPIO_ACTIVE_LOW
		}
	}
};


//static struct device const * dev_spi1 = DEVICE_DT_GET(DT_NODELABEL(spi1));
//static const struct gpio_dt_spec led1 = GPIO_DT_SPEC_GET(DT_NODELABEL(blue_led_1), gpios);
//static const struct gpio_dt_spec led2 = GPIO_DT_SPEC_GET(DT_NODELABEL(green_led_2), gpios);
//static const struct gpio_dt_spec led3 = GPIO_DT_SPEC_GET(DT_NODELABEL(green_led_3), gpios);



static void set8(uint8_t reg, uint8_t value)
{
	uint8_t tx[2];
	uint8_t rx[2];
	tx[0] = MCP356X_COMMAND_BYTE(MCP356X_DEVICE_ADR, reg, MCP356X_CMD_INC_WRITE);
	tx[1] = value;
	struct spi_buf buf_tx[] = {{.buf = &tx,.len = sizeof(tx)}};
	struct spi_buf buf_rx[] = {{.buf = &rx,.len = sizeof(rx)}};
	struct spi_buf_set tx_buf = {.buffers = buf_tx, .count = 1};
	struct spi_buf_set rx_buf = {.buffers = buf_rx, .count = 1};
	spi_transceive_dt(&spi_spec, &tx_buf, &rx_buf);
}


static uint8_t get8(uint8_t reg)
{
	uint8_t tx[2];
	uint8_t rx[2];
	struct spi_buf buf_tx[] = {{.buf = &tx,.len = sizeof(tx)}};
	struct spi_buf buf_rx[] = {{.buf = &rx,.len = sizeof(rx)}};
	struct spi_buf_set tx_buf = {.buffers = buf_tx, .count = 1};
	struct spi_buf_set rx_buf = {.buffers = buf_rx, .count = 1};
	tx[0] = MCP356X_COMMAND_BYTE(MCP356X_DEVICE_ADR, reg, MCP356X_CMD_INC_READ);
	tx[1] = 0; // Need to write in order to read. Exchange 0 for reading data.
	spi_transceive_dt(&spi_spec, &tx_buf, &rx_buf);
	return rx[1];
}

static uint32_t get24(uint8_t reg)
{
	uint8_t tx[4];
	uint8_t rx[4];
	struct spi_buf buf_tx[] = {{.buf = &tx,.len = sizeof(tx)}};
	struct spi_buf buf_rx[] = {{.buf = &rx,.len = sizeof(rx)}};
	struct spi_buf_set tx_buf = {.buffers = buf_tx, .count = 1};
	struct spi_buf_set rx_buf = {.buffers = buf_rx, .count = 1};
	tx[0] = MCP356X_COMMAND_BYTE(MCP356X_DEVICE_ADR, reg, MCP356X_CMD_INC_READ);
	tx[1] = 0; // Need to write in order to read. Exchange 0 for reading data.
	tx[2] = 0; // Need to write in order to read. Exchange 0 for reading data.
	tx[3] = 0; // Need to write in order to read. Exchange 0 for reading data.
	spi_transceive_dt(&spi_spec, &tx_buf, &rx_buf);
	uint32_t v = (rx[1] << 16) | (rx[2] << 8) | (rx[3] << 0);
	return v;
}

static uint32_t get32(uint8_t reg)
{
	uint8_t tx[5];
	uint8_t rx[5];
	struct spi_buf buf_tx[] = {{.buf = &tx,.len = sizeof(tx)}};
	struct spi_buf buf_rx[] = {{.buf = &rx,.len = sizeof(rx)}};
	struct spi_buf_set tx_buf = {.buffers = buf_tx, .count = 1};
	struct spi_buf_set rx_buf = {.buffers = buf_rx, .count = 1};
	tx[0] = MCP356X_COMMAND_BYTE(MCP356X_DEVICE_ADR, reg, MCP356X_CMD_INC_READ);
	tx[1] = 0; // Need to write in order to read. Exchange 0 for reading data.
	tx[2] = 0; // Need to write in order to read. Exchange 0 for reading data.
	tx[3] = 0; // Need to write in order to read. Exchange 0 for reading data.
	tx[4] = 0; // Need to write in order to read. Exchange 0 for reading data.
	spi_transceive_dt(&spi_spec, &tx_buf, &rx_buf);
	uint32_t v = (rx[1] << 24) | (rx[2] << 16) | (rx[3] << 8) | (rx[4] << 0);
	return v;
}

static void mcp356x_data11_get(struct mcp356x_data11 * value)
{
	uint8_t tx[5];
	uint8_t rx[5];
	struct spi_buf buf_tx[] = {{.buf = &tx,.len = sizeof(tx)}};
	struct spi_buf buf_rx[] = {{.buf = &rx,.len = sizeof(rx)}};
	struct spi_buf_set tx_buf = {.buffers = buf_tx, .count = 1};
	struct spi_buf_set rx_buf = {.buffers = buf_rx, .count = 1};
	tx[0] = MCP356X_COMMAND_BYTE(MCP356X_DEVICE_ADR, MCP356X_REG_ADC_DATA, MCP356X_CMD_INC_READ);
	tx[1] = 0; // Need to write in order to read. Exchange 0 for reading data.
	tx[2] = 0; // Need to write in order to read. Exchange 0 for reading data.
	tx[3] = 0; // Need to write in order to read. Exchange 0 for reading data.
	tx[4] = 0; // Need to write in order to read. Exchange 0 for reading data.
	
	printk("rx: %02x %02x %02x %02x %02x\n", rx[0], rx[1], rx[2], rx[3], rx[4]);

	spi_transceive_dt(&spi_spec, &tx_buf, &rx_buf);
	value->channel = rx[1] >> 4;
	uint8_t sign = rx[1] & 0x01;
	value->value = (rx[2] << 16) | (rx[3] << 8) | (rx[4] << 0);
	if (sign != 0)
	{
		value->value -= 16777215;
	}
}


static void set24(uint8_t reg, uint32_t value)
{
	uint8_t tx[4];
	uint8_t rx[4];
	tx[0] = MCP356X_COMMAND_BYTE(MCP356X_DEVICE_ADR, reg, MCP356X_CMD_INC_WRITE);
	tx[1] = ( value >> 16 ) & 0xFF;
	tx[2] = ( value >> 8 ) & 0xFF;
	tx[3] = ( value >> 0 ) & 0xFF;
	struct spi_buf buf_tx[] = {{.buf = &tx,.len = sizeof(tx)}};
	struct spi_buf buf_rx[] = {{.buf = &rx,.len = sizeof(rx)}};
	struct spi_buf_set tx_buf = {.buffers = buf_tx, .count = 1};
	struct spi_buf_set rx_buf = {.buffers = buf_rx, .count = 1};
	spi_transceive_dt(&spi_spec, &tx_buf, &rx_buf);
}



static void set8_verbose(uint8_t reg, uint8_t value)
{
	set8(reg, value);
	uint8_t v = get8(reg);
	printk("SET8: %s: %02x %02x\n", MCP356X_REG_tostring(reg), value, v);
}

static void set24_verbose(uint8_t reg, uint32_t value)
{
	set24(reg, value);
	uint32_t v = get24(reg);
	printk("SET24: %s: %08x %08x\n", MCP356X_REG_tostring(reg), value, v);
}

/*
5.3.1
ANALOG GAIN
The gain settings from 0.33x to 16x are done in the
analog domain. This analog gain is placed on each ADC
differential input. Each doubling of the gain improves the
thermal noise due to sampling by approximately 3 dB,
which means the lowest noise configuration is obtained
when using the highest analog gain. The SNR, however,
is degraded, since doubling the gain factor reduces the
maximum allowable input signal amplitude by
approximately 6 dB.
If the gain is set to 0.33x, the differential input range
theoretically becomes ±3 * VREF. However, the device
does not support input voltages outside of the power
supply voltage range. If large reference voltages are
used with this gain, the input voltage range will be
clipped between AGND and AVDD, and therefore, the
output code span will be limited. This gain is useful
when the reference voltage is small and when the
input signal voltage is large.
The analog gain stage can be used to amplify very low
signals, but the differential input range of the
Delta-Sigma modulator must not be exceeded.
*/
#define MY_GAIN MCP356X_CFG_2_GAIN_X_033

static void init_adc()
{
	printk("Init ADC MCP356X\n");

	set8_verbose(MCP356X_REG_CFG_0,
	MCP356X_CFG_0_VREF_SEL_0 |
	MCP356X_CFG_0_CLK_SEL_2 |
	MCP356X_CFG_0_CS_SEL_0 |
	MCP356X_CFG_0_MODE_CONV
	);
	set8_verbose(MCP356X_REG_CFG_1,
	MCP356X_CFG_1_PRE_1 |
	MCP356X_CFG_1_OSR_32 |
	MCP356X_CFG_1_DITHER_DEF
	);
	set8_verbose(MCP356X_REG_CFG_2,
	MCP356X_CFG_2_BOOST_X_1 |
	//MCP356X_CFG_2_GAIN_X_1 |
	MY_GAIN |
	MCP356X_CFG_2_AZ_MUX_DIS |
	MCP356X_CFG_2_AZ_VREF_EN |
	MCP356X_CFG_2_AZ_FREQ_HIGH
	);
	set8_verbose(MCP356X_REG_CFG_3,
	MCP356X_CFG_3_CONV_MODE_CONT |
	//MCP356X_CFG_3_DATA_FORMAT_DEF |
	MCP356X_CFG_3_DATA_FORMAT_CH_ADC |
	MCP356X_CFG_3_CRC_FORMAT_16 |
	MCP356X_CFG_3_CRC_COM_DIS |
	MCP356X_CFG_3_CRC_OFF_CAL_EN |
	MCP356X_CFG_3_CRC_GAIN_CAL_EN
	);
	set8_verbose(MCP356X_REG_MUX,
	//MCP356X_MUX_VIN_POS_CH0 | 
	//MCP356X_MUX_VIN_NEG_CH1
	//MCP356X_MUX_VIN_POS_CH0 | 
	//MCP356X_MUX_VIN_NEG_AGND
	0
	);
	//set24_verbose(MCP356X_REG_SCAN, 0);
	//set24_verbose(MCP356X_REG_SCAN, MCP356X_SCAN_CH0|MCP356X_SCAN_CH1|MCP356X_SCAN_CH2);
	
	//set24_verbose(MCP356X_REG_IRQ, MCP356X_IRQ_MODE_LOGIC_HIGH);
	set24_verbose(MCP356X_REG_SCAN, MCP356X_SCAN_CH3);
	set24_verbose(MCP356X_REG_OFFSET_CAL, 0);
	set24_verbose(MCP356X_REG_GAIN_CAL, 0x00800000);
	//set24_verbose(MCP356X_RSV_REG_W_A, 0x00900F00);
	set24_verbose(MCP356X_RSV_REG_W_A, 0x00900000);
}





static void adc_print()
{
	/*
	printk("Channel:  ch0  ch1  ch2  ch3  ch4  ch5  ch6  ch7\n"), 
	printk("Voltage: %4i %4i %4i %4i %4i %4i %4i %4i\n", 
	(int)voltage_ch(MCP356X_MUX_VIN_POS_CH0), 
	(int)voltage_ch(MCP356X_MUX_VIN_POS_CH1), 
	(int)voltage_ch(MCP356X_MUX_VIN_POS_CH2), 
	(int)voltage_ch(MCP356X_MUX_VIN_POS_CH3), 
	(int)voltage_ch(MCP356X_MUX_VIN_POS_CH4), 
	(int)voltage_ch(MCP356X_MUX_VIN_POS_CH5), 
	(int)voltage_ch(MCP356X_MUX_VIN_POS_CH6), 
	(int)voltage_ch(MCP356X_MUX_VIN_POS_CH7)
	);
	*/
	// printk("Voltage0: %4i\n", (int)voltage_ch(MCP356X_MUX_VIN_POS_CH0));
	// printk("Voltage7: %4i\n", (int)voltage_ch(MCP356X_MUX_VIN_POS_CH7));
	//printk("ADCDATA: %08x\n", get32(MCP356X_REG_ADC_DATA));
	struct mcp356x_data11 data;
	mcp356x_data11_get(&data);
	printk("Voltage: %02x %08x %08i\n", data.channel, data.value, MCP356X_raw_to_mv(data.value, VREF, MY_GAIN));
}
```

## src/bt.h
```c
#include <stdbool.h>
#include <zephyr/types.h>
#include <stddef.h>
#include <string.h>
#include <errno.h>
#include <sys/printk.h>
#include <sys/byteorder.h>
#include <zephyr.h>

#include <bluetooth/bluetooth.h>
#include <bluetooth/hci.h>
#include <bluetooth/conn.h>
#include <bluetooth/uuid.h>
#include <bluetooth/gatt.h>
#include <bluetooth/services/bas.h>

#define SENSOR_1_NAME				"Temperature Sensor 1"
#define SENSOR_2_NAME				"Temperature Sensor 2"
#define SENSOR_3_NAME				"Humidity Sensor"

/* Sensor Internal Update Interval [seconds] */
#define SENSOR_1_UPDATE_IVAL			5
#define SENSOR_2_UPDATE_IVAL			12
#define SENSOR_3_UPDATE_IVAL			60

/* ESS error definitions */
#define ESS_ERR_WRITE_REJECT			0x80
#define ESS_ERR_COND_NOT_SUPP			0x81

/* ESS Trigger Setting conditions */
#define ESS_TRIGGER_INACTIVE			0x00
#define ESS_FIXED_TIME_INTERVAL			0x01
#define ESS_NO_LESS_THAN_SPECIFIED_TIME		0x02
#define ESS_VALUE_CHANGED			0x03
#define ESS_LESS_THAN_REF_VALUE			0x04
#define ESS_LESS_OR_EQUAL_TO_REF_VALUE		0x05
#define ESS_GREATER_THAN_REF_VALUE		0x06
#define ESS_GREATER_OR_EQUAL_TO_REF_VALUE	0x07
#define ESS_EQUAL_TO_REF_VALUE			0x08
#define ESS_NOT_EQUAL_TO_REF_VALUE		0x09

static ssize_t read_u16(struct bt_conn *conn, const struct bt_gatt_attr *attr,
			void *buf, uint16_t len, uint16_t offset)
{
	const uint16_t *u16 = attr->user_data;
	uint16_t value = sys_cpu_to_le16(*u16);

	return bt_gatt_attr_read(conn, attr, buf, len, offset, &value,
				 sizeof(value));
}

/* Environmental Sensing Service Declaration */

struct es_measurement {
	uint16_t flags; /* Reserved for Future Use */
	uint8_t sampling_func;
	uint32_t meas_period;
	uint32_t update_interval;
	uint8_t application;
	uint8_t meas_uncertainty;
};

struct temperature_sensor {
	int16_t temp_value;

	/* Valid Range */
	int16_t lower_limit;
	int16_t upper_limit;

	/* ES trigger setting - Value Notification condition */
	uint8_t condition;
	union {
		uint32_t seconds;
		int16_t ref_val; /* Reference temperature */
	};

	struct es_measurement meas;
};

struct humidity_sensor {
	int16_t humid_value;

	struct es_measurement meas;
};

static bool simulate_temp;
static struct temperature_sensor sensor_1 = {
		.temp_value = 1200,
		.lower_limit = -10000,
		.upper_limit = 10000,
		.condition = ESS_VALUE_CHANGED,
		.meas.sampling_func = 0x00,
		.meas.meas_period = 0x01,
		.meas.update_interval = SENSOR_1_UPDATE_IVAL,
		.meas.application = 0x1c,
		.meas.meas_uncertainty = 0x04,
};

static struct temperature_sensor sensor_2 = {
		.temp_value = 1800,
		.lower_limit = -1000,
		.upper_limit = 5000,
		.condition = ESS_VALUE_CHANGED,
		.meas.sampling_func = 0x00,
		.meas.meas_period = 0x01,
		.meas.update_interval = SENSOR_2_UPDATE_IVAL,
		.meas.application = 0x1b,
		.meas.meas_uncertainty = 0x04,
};

static struct humidity_sensor sensor_3 = {
		.humid_value = 6233,
		.meas.sampling_func = 0x02,
		.meas.meas_period = 0x0e10,
		.meas.update_interval = SENSOR_3_UPDATE_IVAL,
		.meas.application = 0x1c,
		.meas.meas_uncertainty = 0x01,
};

static void temp_ccc_cfg_changed(const struct bt_gatt_attr *attr,
				 uint16_t value)
{
	simulate_temp = value == BT_GATT_CCC_NOTIFY;
}

struct read_es_measurement_rp {
	uint16_t flags; /* Reserved for Future Use */
	uint8_t sampling_function;
	uint8_t measurement_period[3];
	uint8_t update_interval[3];
	uint8_t application;
	uint8_t measurement_uncertainty;
} __packed;

static ssize_t read_es_measurement(struct bt_conn *conn,
				   const struct bt_gatt_attr *attr, void *buf,
				   uint16_t len, uint16_t offset)
{
	const struct es_measurement *value = attr->user_data;
	struct read_es_measurement_rp rsp;

	rsp.flags = sys_cpu_to_le16(value->flags);
	rsp.sampling_function = value->sampling_func;
	sys_put_le24(value->meas_period, rsp.measurement_period);
	sys_put_le24(value->update_interval, rsp.update_interval);
	rsp.application = value->application;
	rsp.measurement_uncertainty = value->meas_uncertainty;

	return bt_gatt_attr_read(conn, attr, buf, len, offset, &rsp,
				 sizeof(rsp));
}

static ssize_t read_temp_valid_range(struct bt_conn *conn,
				     const struct bt_gatt_attr *attr, void *buf,
				     uint16_t len, uint16_t offset)
{
	const struct temperature_sensor *sensor = attr->user_data;
	uint16_t tmp[] = {sys_cpu_to_le16(sensor->lower_limit),
			  sys_cpu_to_le16(sensor->upper_limit)};

	return bt_gatt_attr_read(conn, attr, buf, len, offset, tmp,
				 sizeof(tmp));
}

struct es_trigger_setting_seconds {
	uint8_t condition;
	uint8_t sec[3];
} __packed;

struct es_trigger_setting_reference {
	uint8_t condition;
	int16_t ref_val;
} __packed;

static ssize_t read_temp_trigger_setting(struct bt_conn *conn,
					 const struct bt_gatt_attr *attr,
					 void *buf, uint16_t len,
					 uint16_t offset)
{
	const struct temperature_sensor *sensor = attr->user_data;

	switch (sensor->condition) {
	/* Operand N/A */
	case ESS_TRIGGER_INACTIVE:
		__fallthrough;
	case ESS_VALUE_CHANGED:
		return bt_gatt_attr_read(conn, attr, buf, len, offset,
					 &sensor->condition,
					 sizeof(sensor->condition));
	/* Seconds */
	case ESS_FIXED_TIME_INTERVAL:
		__fallthrough;
	case ESS_NO_LESS_THAN_SPECIFIED_TIME: {
			struct es_trigger_setting_seconds rp;

			rp.condition = sensor->condition;
			sys_put_le24(sensor->seconds, rp.sec);

			return bt_gatt_attr_read(conn, attr, buf, len, offset,
						 &rp, sizeof(rp));
		}
	/* Reference temperature */
	default: {
			struct es_trigger_setting_reference rp;

			rp.condition = sensor->condition;
			rp.ref_val = sys_cpu_to_le16(sensor->ref_val);

			return bt_gatt_attr_read(conn, attr, buf, len, offset,
						 &rp, sizeof(rp));
		}
	}
}

static bool check_condition(uint8_t condition, int16_t old_val, int16_t new_val,
			    int16_t ref_val)
{
	switch (condition) {
	case ESS_TRIGGER_INACTIVE:
		return false;
	case ESS_FIXED_TIME_INTERVAL:
	case ESS_NO_LESS_THAN_SPECIFIED_TIME:
		/* TODO: Check time requirements */
		return false;
	case ESS_VALUE_CHANGED:
		return new_val != old_val;
	case ESS_LESS_THAN_REF_VALUE:
		return new_val < ref_val;
	case ESS_LESS_OR_EQUAL_TO_REF_VALUE:
		return new_val <= ref_val;
	case ESS_GREATER_THAN_REF_VALUE:
		return new_val > ref_val;
	case ESS_GREATER_OR_EQUAL_TO_REF_VALUE:
		return new_val >= ref_val;
	case ESS_EQUAL_TO_REF_VALUE:
		return new_val == ref_val;
	case ESS_NOT_EQUAL_TO_REF_VALUE:
		return new_val != ref_val;
	default:
		return false;
	}
}

static void update_temperature(struct bt_conn *conn,
			       const struct bt_gatt_attr *chrc, int16_t value,
			       struct temperature_sensor *sensor)
{
	bool notify = check_condition(sensor->condition,
				      sensor->temp_value, value,
				      sensor->ref_val);

	/* Update temperature value */
	sensor->temp_value = value;

	/* Trigger notification if conditions are met */
	if (notify) {
		value = sys_cpu_to_le16(sensor->temp_value);

		bt_gatt_notify(conn, chrc, &value, sizeof(value));
	}
}

BT_GATT_SERVICE_DEFINE(ess_svc,
	BT_GATT_PRIMARY_SERVICE(BT_UUID_ESS),

	/* Temperature Sensor 1 */
	BT_GATT_CHARACTERISTIC(BT_UUID_TEMPERATURE,
			       BT_GATT_CHRC_READ | BT_GATT_CHRC_NOTIFY,
			       BT_GATT_PERM_READ,
			       read_u16, NULL, &sensor_1.temp_value),
	BT_GATT_DESCRIPTOR(BT_UUID_ES_MEASUREMENT, BT_GATT_PERM_READ,
			   read_es_measurement, NULL, &sensor_1.meas),
	BT_GATT_CUD(SENSOR_1_NAME, BT_GATT_PERM_READ),
	BT_GATT_DESCRIPTOR(BT_UUID_VALID_RANGE, BT_GATT_PERM_READ,
			   read_temp_valid_range, NULL, &sensor_1),
	BT_GATT_DESCRIPTOR(BT_UUID_ES_TRIGGER_SETTING,
			   BT_GATT_PERM_READ, read_temp_trigger_setting,
			   NULL, &sensor_1),
	BT_GATT_CCC(temp_ccc_cfg_changed,
		    BT_GATT_PERM_READ | BT_GATT_PERM_WRITE),

	/* Temperature Sensor 2 */
	BT_GATT_CHARACTERISTIC(BT_UUID_TEMPERATURE,
			       BT_GATT_CHRC_READ | BT_GATT_CHRC_NOTIFY,
			       BT_GATT_PERM_READ,
			       read_u16, NULL, &sensor_2.temp_value),
	BT_GATT_DESCRIPTOR(BT_UUID_ES_MEASUREMENT, BT_GATT_PERM_READ,
			   read_es_measurement, NULL, &sensor_2.meas),
	BT_GATT_CUD(SENSOR_2_NAME, BT_GATT_PERM_READ),
	BT_GATT_DESCRIPTOR(BT_UUID_VALID_RANGE, BT_GATT_PERM_READ,
			   read_temp_valid_range, NULL, &sensor_2),
	BT_GATT_DESCRIPTOR(BT_UUID_ES_TRIGGER_SETTING,
			   BT_GATT_PERM_READ, read_temp_trigger_setting,
			   NULL, &sensor_2),
	BT_GATT_CCC(temp_ccc_cfg_changed,
		    BT_GATT_PERM_READ | BT_GATT_PERM_WRITE),

	/* Humidity Sensor */
	BT_GATT_CHARACTERISTIC(BT_UUID_HUMIDITY, BT_GATT_CHRC_READ,
			       BT_GATT_PERM_READ,
			       read_u16, NULL, &sensor_3.humid_value),
	BT_GATT_CUD(SENSOR_3_NAME, BT_GATT_PERM_READ),
	BT_GATT_DESCRIPTOR(BT_UUID_ES_MEASUREMENT, BT_GATT_PERM_READ,
			   read_es_measurement, NULL, &sensor_3.meas),
);

static void ess_simulate(void)
{
	static uint8_t i;
	uint16_t val;

	if (!(i % SENSOR_1_UPDATE_IVAL)) {
		val = 1200 + i;
		update_temperature(NULL, &ess_svc.attrs[2], val, &sensor_1);
	}

	if (!(i % SENSOR_2_UPDATE_IVAL)) {
		val = 1800 + i;
		update_temperature(NULL, &ess_svc.attrs[9], val, &sensor_2);
	}

	if (!(i % SENSOR_3_UPDATE_IVAL)) {
		sensor_3.humid_value = 6233 + (i % 13);
	}

	if (!(i % INT8_MAX)) {
		i = 0U;
	}

	i++;
}

static const struct bt_data ad[] = {
	BT_DATA_BYTES(BT_DATA_FLAGS, (BT_LE_AD_GENERAL | BT_LE_AD_NO_BREDR)),
	BT_DATA_BYTES(BT_DATA_GAP_APPEARANCE, 0x00, 0x03),
	BT_DATA_BYTES(BT_DATA_UUID16_ALL,
		      BT_UUID_16_ENCODE(BT_UUID_ESS_VAL),
		      BT_UUID_16_ENCODE(BT_UUID_BAS_VAL)),
};

static void connected(struct bt_conn *conn, uint8_t err)
{
	if (err) {
		printk("Connection failed (err 0x%02x)\n", err);
	} else {
		printk("Connected\n");
	}
}

static void disconnected(struct bt_conn *conn, uint8_t reason)
{
	printk("Disconnected (reason 0x%02x)\n", reason);
}

BT_CONN_CB_DEFINE(conn_callbacks) = {
	.connected = connected,
	.disconnected = disconnected,
};

static void bt_ready(void)
{
	int err;

	printk("Bluetooth initialized\n");

	err = bt_le_adv_start(BT_LE_ADV_CONN_NAME, ad, ARRAY_SIZE(ad), NULL, 0);
	if (err) {
		printk("Advertising failed to start (err %d)\n", err);
		return;
	}

	printk("Advertising successfully started\n");
}

static void auth_passkey_display(struct bt_conn *conn, unsigned int passkey)
{
	char addr[BT_ADDR_LE_STR_LEN];

	bt_addr_le_to_str(bt_conn_get_dst(conn), addr, sizeof(addr));

	printk("Passkey for %s: %06u\n", addr, passkey);
}

static void auth_cancel(struct bt_conn *conn)
{
	char addr[BT_ADDR_LE_STR_LEN];

	bt_addr_le_to_str(bt_conn_get_dst(conn), addr, sizeof(addr));

	printk("Pairing cancelled: %s\n", addr);
}

static struct bt_conn_auth_cb auth_cb_display = {
	.passkey_display = auth_passkey_display,
	.passkey_entry = NULL,
	.cancel = auth_cancel,
};

static void bas_notify(void)
{
	uint8_t battery_level = bt_bas_get_battery_level();

	battery_level--;

	if (!battery_level) {
		battery_level = 100U;
	}

	bt_bas_set_battery_level(battery_level);
}







static void mybt_init(void)
{
	int err;

	err = bt_enable(NULL);
	if (err) {
		printk("Bluetooth init failed (err %d)\n", err);
		return;
	}

	bt_ready();

	bt_conn_auth_cb_register(&auth_cb_display);
}



static void mybt_progress(void)
{

	/* Temperature simulation */
	if (simulate_temp) {
		ess_simulate();
	}

	/* Battery level simulation */
	bas_notify();

}
```
